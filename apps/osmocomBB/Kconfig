## apps/osmocomBB/Kconfig
```kconfig
#
# For a description of the syntax of this configuration file,
# see misc/tools/kconfig-language.txt.
#

source "$APPSDIR/osmocomBB/layer1/Kconfig"
```

## apps/osmocomBB/layer1/Kconfig
```kconfig
#
# For a description of the syntax of this configuration file,
# see misc/tools/kconfig-language.txt.
#

config OSMOCOMBB_LAYER1
	bool "Layer1 GSM application"
	default n
	---help---
		Layer1 GSM application

if OSMOCOMBB_LAYER1

config OSMOCOMBB_LAYER1_PROGNAME
        string "Program name"
        default "layer1"
        depends on BUILD_KERNEL
        ---help---
                This is the name of the program that will be use when the NSH ELF
                program is installed.

endif
```

## nuttx/arch/arm/src/mt6260/Kconfig
```kconfig
#
# For a description of the syntax of this configuration file,
# see misc/tools/kconfig-language.txt.
#

if ARCH_CHIP_MT6260
comment "MT6260 Configuration Options"

menu "MT6260 Peripheral Selections"

config MT6260_UART0
	bool "UART0 support"
	default y
	select ARCH_HAVE_UART0

config MT6260_UART1
	bool "UART1 support"
	default y
	select ARCH_HAVE_UART1

config MT6260_USB
  bool "USB Peripheral support"
  default y
  help
    Enable allowing the MT6260 to act as a USB peripheral.

endmenu # MT6260 Peripheral Selections
endif # ARCH_CHIP_MT6260
```
